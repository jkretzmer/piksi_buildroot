## package/sbp_json_bridge/Config.in
```kconfig
config BR2_PACKAGE_SBP_JSON_BRIDGE
	bool "sbp_json_bridge"
	select BR2_PACKAGE_CZMQ
	select BR2_PACKAGE_LIBSBP
	select BR2_PACKAGE_LIBPIKSI
```

## package/sbp_json_lws/Config.in
```kconfig
config BR2_PACKAGE_SBP_JSON_LWS
	bool "sbp_json_lws"
	select BR2_PACKAGE_CZMQ
	select BR2_PACKAGE_LIBSBP
	select BR2_PACKAGE_LIBPIKSI
	select BR2_PACKAGE_LIBWEBSOCKETS
```
